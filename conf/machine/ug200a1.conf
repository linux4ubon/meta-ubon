## conf/machine/ug200a1.conf
```bitbake
#@TYPE: Machine
#@NAME: NXP i.MX6Q SABRE Smart Device
#@SOC: i.MX6Q
#@DESCRIPTION: Machine configuration for NXP i.MX6Q SABRE Smart Device
#@MAINTAINER: Otavio Salvador <otavio@ossystems.com.br>

MACHINEOVERRIDES =. "mx6:mx6q:"

require conf/machine/include/imx-base.inc
require conf/machine/include/tune-cortexa9.inc

KERNEL_DEVICETREE = "imx6q-ug200a1.dtb "

MACHINE_FEATURES_remove = " optee"

UBOOT_CONFIG ??= "1G"
UBOOT_CONFIG[1G] = "ubon_ug200a1_config,sdcard"

OPTEE_BIN_EXT = "6qsdb"

SERIAL_CONSOLES = "115200;ttymxc1"

MACHINE_FIRMWARE_append_mx6 = " linux-firmware-ath6k"

MACHINE_FEATURES += " pci wifi bluetooth"
```
